#include <WiFi.h>
#include <AsyncTCP.h>
#include <ESPAsyncWebServer.h>
#include "mbedtls/md.h"
#include <Wire.h>
#include <Adafruit_GFX.h>
#include <Adafruit_SSD1306.h>
#include <Keypad.h>
#include <Adafruit_Fingerprint.h>
#include <HardwareSerial.h>

#define SCREEN_WIDTH 128     // OLED display width, in pixels
#define SCREEN_HEIGHT 64     // OLED display height, in pixels
#define OLED_RESET -1        // Reset pin # (or -1 if sharing Arduino reset pin)
#define SCREEN_ADDRESS 0x3C  // See datasheet for Address; 0x3D for 128x64, 0x3C for 128x32

#define RX2_PIN 16  // Sensor's TX (white wire)
#define TX2_PIN 17  // Sensor's RX (green wire)

const byte ROWS = 4; 
const byte COLS = 4; 

char keys[ROWS][COLS] = {
  { '1', '2', '3', 'A' },
  { '4', '5', '6', 'B' },
  { '7', '8', '9', 'C' },
  { '*', '0', '#', 'D' }
};

byte rowPins[ROWS] = { 13, 12, 14, 27 };  
byte colPins[COLS] = { 26, 25, 33, 32 }; 

Keypad keypad = Keypad(makeKeymap(keys), rowPins, colPins, ROWS, COLS);
Adafruit_SSD1306 display(SCREEN_WIDTH, SCREEN_HEIGHT, &Wire, OLED_RESET);
HardwareSerial mySerial(2); // Use UART2 (Serial2) on ESP32
Adafruit_Fingerprint finger = Adafruit_Fingerprint(&mySerial);

const char *ssid = "Biometric_Based_Payment_System";
const char *password = "123456789";

struct User {
  int id;
  String name;
  float balance;
  String password;
  bool isAdmin;
};

User users[10];
int userCount = 0;

AsyncWebServer server(80);

String hashPassword(const char *password) {
  String salt = "123";  // Simple fixed salt for demonstration
  String salting = String(password) + salt;
  unsigned char hash[32];
  char outputBuffer[65];
  mbedtls_md_context_t ctx;
  mbedtls_md_type_t md_type = MBEDTLS_MD_SHA256;

  mbedtls_md_init(&ctx);
  mbedtls_md_setup(&ctx, mbedtls_md_info_from_type(md_type), 0);
  mbedtls_md_starts(&ctx);
  mbedtls_md_update(&ctx, (const unsigned char *)salting.c_str(), salting.length());
  mbedtls_md_finish(&ctx, hash);
  mbedtls_md_free(&ctx);

  for (int i = 0; i < 32; i++) {
    sprintf(outputBuffer + (i * 2), "%02x", hash[i]);
  }

  return String(outputBuffer);
}

#define LOGO_WIDTH 128
#define LOGO_HEIGHT 64
static const unsigned char PROGMEM logo_bmp[] = {
  0x00, 0x00, 0x00, 0x00, 0x00, 0x00, 0x00, 0x00, 0x00, 0x00, 0x00, 0x00, 0x00, 0x00, 0x00, 0x00,
  0x00, 0x00, 0x00, 0x00, 0x00, 0x00, 0x00, 0x00, 0x00, 0x00, 0x00, 0x00, 0x00, 0x00, 0x00, 0x00,
  0x00, 0x00, 0x00, 0x00, 0x00, 0x00, 0x03, 0xff, 0xc0, 0x00, 0x00, 0x00, 0x00, 0x00, 0x00, 0x00,
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  0x00, 0x00, 0x00, 0x00, 0x00, 0x00, 0x00, 0x00, 0x00, 0x00, 0x00, 0x00, 0x00, 0x00, 0x00, 0x00
};

#define FinPr_valid_width 64
#define FinPr_valid_height 64
const uint8_t PROGMEM FinPr_valid_bits[] = {
  0x00, 0x00, 0x03, 0xfe, 0x00, 0x00, 0x00, 0x00, 0x00, 0x00, 0x1f, 0xff, 0xe0, 0x00, 0x00, 0x00,
  0x00, 0x00, 0x7f, 0xff, 0xf8, 0x00, 0x00, 0x00, 0x00, 0x00, 0xfc, 0x00, 0xfe, 0x00, 0x00, 0x00,
  0x00, 0x03, 0xe0, 0x00, 0x1f, 0x00, 0x00, 0x00, 0x00, 0x07, 0xc0, 0x00, 0x07, 0x80, 0x00, 0x00,
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  0x00, 0x00, 0x03, 0xe0, 0xe3, 0xff, 0xe0, 0x00, 0x00, 0x00, 0x01, 0x80, 0x00, 0x7f, 0x00, 0x00
};

#define FinPr_invalid_width 64
#define FinPr_invalid_height 64
const uint8_t PROGMEM FinPr_invalid_bits[] = {
  0x00, 0x00, 0x03, 0xfe, 0x00, 0x00, 0x00, 0x00, 0x00, 0x00, 0x1f, 0xff, 0xe0, 0x00, 0x00, 0x00,
  0x00, 0x00, 0x7f, 0xff, 0xf8, 0x00, 0x00, 0x00, 0x00, 0x00, 0xfc, 0x00, 0xfe, 0x00, 0x00, 0x00,
  0x00, 0x03, 0xe0, 0x00, 0x1f, 0x00, 0x00, 0x00, 0x00, 0x07, 0xc0, 0x00, 0x07, 0x80, 0x00, 0x00,
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  0x00, 0x00, 0x03, 0xe0, 0xe3, 0xff, 0xe0, 0x00, 0x00, 0x00, 0x01, 0x80, 0x00, 0x7f, 0x00, 0x00
};

void setup() {
  Serial.begin(115200);

  if (!display.begin(SSD1306_SWITCHCAPVCC, SCREEN_ADDRESS)) {
    Serial.println(F("SSD1306 allocation failed"));
    while(1){
      delay(1000);
    }
  }
  
  while (!Serial);  // Wait for console to open, necessary for native USB
  delay(100);

  display.clearDisplay();
  display.drawBitmap(0, 0, logo_bmp, LOGO_WIDTH, LOGO_HEIGHT, 1);
  display.display();

  mySerial.begin(57600, SERIAL_8N1, RX2_PIN, TX2_PIN);
  finger.begin(57600);
  if (finger.verifyPassword()) {
    Serial.println("Found fingerprint sensor!");
  } else {
    Serial.println("Did not find fingerprint sensor :(");
   while (1) { 
      delay(1000); 
    }
  }

  Serial.println(F("Reading sensor parameters"));
  finger.getParameters();
  Serial.print(F("Status: 0x")); Serial.println(finger.status_reg, HEX);
  Serial.print(F("Sys ID: 0x")); Serial.println(finger.system_id, HEX);
  Serial.print(F("Capacity: ")); Serial.println(finger.capacity);
  Serial.print(F("Security level: ")); Serial.println(finger.security_level);
  Serial.print(F("Device address: ")); Serial.println(finger.device_addr, HEX);
  Serial.print(F("Packet len: ")); Serial.println(finger.packet_len);
  Serial.print(F("Baud rate: ")); Serial.println(finger.baud_rate);

  WiFi.softAP(ssid, password);
  IPAddress IP = WiFi.softAPIP();
  Serial.println("AP IP address: " + IP.toString());

  // Initialize predefined users
  users[userCount++] = { 1, "Shreyas", 100.0, hashPassword("adminpass"), true };
  users[userCount++] = { 2, "Suhas", 150.5, hashPassword("pass1"), false };
  users[userCount++] = { 3, "Vyshnavi", 200.75, hashPassword("pass2"), false };
  users[userCount++] = { 4, "Chitra", 300.0, hashPassword("pass3"), false };

  server.on("/", HTTP_GET, [](AsyncWebServerRequest *request) {
    String message = "";
    if (request->hasParam("message")) {
      message = request->getParam("message")->value();
    }
    request->send(200, "text/html", generateAdminDashboardPage(message));
  });

  server.on("/login", HTTP_POST, [](AsyncWebServerRequest *request) {
    if (!request->hasParam("id", true) || !request->hasParam("password", true)) {
      request->send(400, "text/html", "Bad Request - Missing Parameters!");
      return;
    }
    int id = request->getParam("id", true)->value().toInt();
    String password = request->getParam("password", true)->value();
    if (authenticateUser(id, hashPassword(password.c_str()))) {
      User &user = users[id - 1];  // Adjust index for zero-based array
      if (user.isAdmin) {
        request->redirect("/");
      } else {
        request->send(200, "text/html", generateDashboardPage(user));
      }
    } else {
      request->send(401, "text/html", "Unauthorized - Incorrect ID or Password!");
    }
  });

  server.on("/adduser", HTTP_POST, [](AsyncWebServerRequest *request) {
    if (userCount < 10 && request->hasParam("name", true) && request->hasParam("balance", true) && request->hasParam("password", true)) {
      String name = request->getParam("name", true)->value();
      float balance = request->getParam("balance", true)->value().toFloat();
      String password = hashPassword(request->getParam("password", true)->value().c_str());
      users[userCount++] = { userCount + 1, name, balance, password, false };
      request->redirect("/?message=User added successfully");
    } else {
      request->redirect("/?message=Error or maximum user limit reached");
    }
  });

  server.on("/addmoney", HTTP_POST, [](AsyncWebServerRequest *request) {
    if (request->hasParam("id", true) && request->hasParam("amount", true)) {
      int id = request->getParam("id", true)->value().toInt();
      float amount = request->getParam("amount", true)->value().toFloat();
      for (int i = 0; i < userCount; i++) {
        if (users[i].id == id) {
          users[i].balance += amount;
          break;
        }
      }
      request->redirect("/?message=Money added successfully");
    } else {
      request->send(400, "text/html", "Missing parameters!");
    }
  });

  server.on("/removeuser", HTTP_GET, [](AsyncWebServerRequest *request) {
    if (request->hasParam("id")) {
      int id = request->getParam("id")->value().toInt();
      removeUser(id);
      request->redirect("/?message=User removed successfully");
    } else {
      request->send(400, "text/html", "Missing user ID for removal.");
    }
  });

  server.on("/logout", HTTP_POST, [](AsyncWebServerRequest *request) {
    request->send(200, "text/html", loginPage());
  });

  server.begin();
}

void loop() {
  display.clearDisplay();
  display.drawBitmap(0, 0, logo_bmp, LOGO_WIDTH, LOGO_HEIGHT, 1);
  display.display();
  int userId = getUserID();
  if (userId != -1) {
    User &user = users[userId - 1];
    displayUserName(user);
    display.clearDisplay();
    display.setTextSize(2);
    display.setCursor(0, 0);
    display.println("A:Balance");
    display.println("B:Add Amt.");
    display.println("C:Pay");
    display.println("D:Exit");
    display.display();

    char key = '\0';
    while (key != 'A' && key != 'B' && key != 'C' && key != 'D') {
      key = keypad.getKey();
    }

    if (key) {
      switch (key) {
        case 'A':
          displayUserMenu(user);
          break;
        case 'B':
          addMoney(user);
          break;
        case 'C':
          handlePayment(user);
          break;
        case 'D':
          break;
      }
    }
  }
  delay(50);
}

bool authenticateUser(int id, String hashedPassword) {
  for (int i = 0; i < userCount; i++) {
    if (users[i].id == id && users[i].password == hashedPassword) {
      return true;
    }
  }
  return false;
}

void removeUser(int id) {
  int index = -1;
  for (int i = 0; i < userCount; i++) {
    if (users[i].id == id) {
      index = i;
      break;
    }
  }
  if (index != -1) {
    for (int i = index; i < userCount - 1; i++) {
      users[i] = users[i + 1];
    }
    userCount--;
  }
}

String loginPage() {
  return R"rawliteral(
<!DOCTYPE html>
<html lang="en">
<head>
    <meta charset="UTF-8">
    <title>Login</title>
    <style>
        body { font-family: Arial, sans-serif; background-color: #f4f4f4; display: flex; justify-content: center; align-items: center; height: 100vh; margin: 0; }
        .login-container { background: white; padding: 20px 40px; border-radius: 8px; box-shadow: 0 4px 8px rgba(0,0,0,0.1); }
        h2 { color: #333; }
        form { margin-top: 20px; }
        input[type="number"], input[type="password"], input[type="submit"] { width: 100%; padding: 10px; margin-top: 10px; border: 1px solid #ccc; border-radius: 4px; box-sizing: border-box; }
        input[type="submit"] { background-color: #4CAF50; color: white; border: none; cursor: pointer; }
        input[type="submit"]:hover { background-color: #45a049; }
    </style>
</head>
<body>
    <div class="login-container">
        <h2>Login</h2>
        <form action="/login" method="post">
            <input type="number" name="id" placeholder="User ID" required>
            <input type="password" name="password" placeholder="Password" required>
            <input type="submit" value="Login">
        </form>
    </div>
</body>
</html>
    )rawliteral";
}

String generateAdminDashboardPage(String message) {
  String page = R"rawliteral(
<!DOCTYPE html>
<html lang="en">
<head>
    <meta charset="UTF-8">
    <title>Admin Dashboard</title>
    <style>
        body { font-family: Arial, sans-serif; background-color: #f4f4f4; padding: 20px; }
        h1 { color: #333; }
        .message { color: green; }
        ul { list-style-type: none; padding: 0; }
        li { margin: 10px 0; padding: 10px; background-color: #fff; border-radius: 4px; box-shadow: 0 2px 4px rgba(0,0,0,0.1); display: flex; justify-content: space-between; align-items: center; }
        form { margin-top: 20px; }
        input[type="text"], input[type="number"], input[type="password"], input[type="submit"] { width: 100%; padding: 8px; margin-top: 10px; border: 1px solid #ccc; border-radius: 4px; box-sizing: border-box; }
        input[type="submit"] { background-color: #4CAF50; color: white; cursor: pointer; }
        input[type="submit"]:hover { background-color: #45a049; }
        .button-link { background: none; border: none; color: #007BFF; text-decoration: underline; cursor: pointer; }
        .button-link:hover { color: #0056b3; }
    </style>
</head>
<body>
    <h1>Admin Dashboard</h1>
    <div class="message">)rawliteral"
                + message + R"rawliteral(</div>
    <ul>
    )rawliteral";

  for (int i = 0; i < userCount; i++) {
    page += "<li>" + String(users[i].id) + " - " + users[i].name + " - ₹" + String(users[i].balance, 2);
    page += "<form style='margin: 0;' action='/removeuser' method='get'><input type='hidden' name='id' value='" + String(users[i].id) + "'><button type='submit' class='button-link'>Remove</button></form>";
    page += "<form style='margin: 0;' action='/addmoney' method='post'><input type='hidden' name='id' value='" + String(users[i].id) + "'><input type='number' name='amount' placeholder='Amount' style='width: auto;'><button type='submit'>Add Money</button></form></li>";
  }

  page += R"rawliteral(
    </ul>
    <h2>Add New User</h2>
    <form action="/adduser" method="post">
        <input type="text" name="name" placeholder="Enter user name" required>
        <input type="number" name="balance" placeholder="Initial balance" required>
        <input type="password" name="password" placeholder="Password" required>
        <input type="submit" value="Add User">
    </form>
    <form action='/logout' method='post'><input type='submit' value='Logout'></form>
</body>
</html>
    )rawliteral";
  return page;
}

String generateDashboardPage(User user) {
  return R"rawliteral(
<!DOCTYPE html>
<html lang="en">
<head>
    <meta charset="UTF-8">
    <title>Dashboard</title>
    <style>
        body { font-family: Arial, sans-serif; background-color: #f4f4f4; padding: 20px; }
        h1 { color: #333; }
        p { background-color: #fff; padding: 10px; border-radius: 4px; box-shadow: 0 2px 4px rgba(0,0,0,0.1); }
        form { margin-top: 20px; }
        input[type="submit"] { background-color: #4CAF50; color: white; padding: 10px 20px; border: none; border-radius: 4px; cursor: pointer; }
        input[type="submit"]:hover { background-color: #45a049; }
    </style>
</head>
<body>
    <h1>Welcome, )rawliteral"
         + user.name + R"rawliteral(</h1>
    <p>Your balance is ₹)rawliteral"
         + String(user.balance, 2) + R"rawliteral(</p>
    <form action='/logout' method='post'><input type='submit' value='Logout'></form>
</body>
</html>
    )rawliteral";
}

int getUserID() {
  if (finger.getImage() == FINGERPRINT_OK) {
    if (finger.image2Tz() == FINGERPRINT_OK) {
      if (finger.fingerFastSearch() == FINGERPRINT_OK) {
        Serial.print("Found ID #");
        Serial.print(finger.fingerID);
        Serial.print(" with confidence of ");
        Serial.println(finger.confidence);
        display.clearDisplay();
        display.drawBitmap(34, 0, FinPr_valid_bits, FinPr_valid_width, FinPr_valid_height, WHITE);
        display.display();
        return finger.fingerID;
      } else {
        display.clearDisplay();
        display.drawBitmap(34, 0, FinPr_invalid_bits, FinPr_invalid_width, FinPr_invalid_height, WHITE);
        display.display();
        delay(2000);
        display.clearDisplay();
        display.setTextSize(2);               // Normal 1:1 pixel scale
        display.setTextColor(SSD1306_WHITE);  // Draw white text
        display.setCursor(20, 0);             // Start at top-left corner
        display.println(("Invalid"));
        display.setCursor(25, 20);
        display.println("Finger");
        display.setCursor(10, 40);
        display.println("Try Again");
        display.display();
        Serial.println("Not Valid Finger");
        delay(3000);
        display.clearDisplay();
      }
    }
  }
  return -1;  // return -1 if no valid fingerprint found
}


void displayUserName(User &user) {
  display.clearDisplay();
  display.setTextSize(2);               // Normal 1:1 pixel scale
  display.setTextColor(SSD1306_WHITE);  // Draw white text
  display.setCursor(20, 0);             // Start at top-left corner
  display.println("Welcome");
  display.setCursor(0, 20);  // Start at top-left corner
  display.println(user.name);
  display.display();
  delay(2000);
}

void displayUserMenu(User &user) {
  display.clearDisplay();
  display.setTextSize(2);       // Normal 1:1 pixel scale
  display.setTextColor(WHITE);  // Draw white text
  display.setCursor(0, 0);
  display.println(user.name);  // Display the authenticated user's name
  display.setCursor(0, 20);
  display.println("Balance:");
  display.setCursor(0, 40);
  display.println(user.balance, 2);  // Display the balance with 2 decimal places
  display.display();
  delay(5000);
}

void addMoney(User &user) {
  float amount = 0.0;
  bool amountEntered = false;

  while (!amountEntered) {
    amount = getKeypadNumber();
    if (amount > 0.0) {
      amountEntered = true;
    }
  }

  user.balance += amount;
  display.clearDisplay();
  display.setCursor(0, 0);
  display.setTextSize(2);
  display.println("Added: ");
  display.println(String(amount));
  display.println("Balance: ");
  display.println(String(user.balance));
  display.display();
  delay(5000);
}

void handlePayment(User &user) {
  float amount = 0.0;
  bool amountEntered = false;

  while (!amountEntered) {
    amount = getKeypadNumber();
    if (amount > 0.0) {
      amountEntered = true;
    }
  }

  if (user.balance >= amount) {
    user.balance -= amount;
    display.clearDisplay();
    display.setTextSize(2);
    display.setCursor(0, 0);
    display.println("Paid: ");
    display.println(String(amount));
    display.println("Balance: ");
    display.println(String(user.balance));
  } else {
    display.clearDisplay();
    display.setCursor(0, 0);
    display.println("INSUFF-");
    display.println("-CIENT");
    display.println("FUNDS");
  }
  display.display();
  delay(5000);
}

float getKeypadNumber() {
  float number = 0.0;
  bool isNumber = false;
  display.clearDisplay();
  display.setTextSize(2);
  display.setCursor(0, 0);
  display.println("Enter");
  display.println("Amount:");
  display.display();
  String input = "";
  while (!isNumber) {
    char key = keypad.getKey();
    if (key) {
      if (key == '#') {
        if (input.length() > 0) {
          number = input.toFloat();
          isNumber = true;
        }
      } else if (isdigit(key) || key == '.') {
        input += key;
        display.print(key);
        display.display();
      }
    }
    delay(100);
  }
  return number;
}